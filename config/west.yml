## config/west.yml
```yaml
manifest:
  defaults:
    revision: v0.2
  remotes:
    - name: zmkfirmware
      url-base: https://github.com/zmkfirmware
    - name: boysonline
      url-base: https://github.com/boysonline
  projects:
    - name: zmk
      remote: zmkfirmware
      revision: main
      import: app/west.yml
    - name: zmk-keyboard-rapolas7
      remote: boysonline
      revision: main
      path: ../modules/zmk-keyboard-rapolas7
  self:
    path: config
```
